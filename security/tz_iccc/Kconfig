## security/tz_iccc/Kconfig
```kconfig
#
# TZ iccc configuration
#
config TZ_ICCC_MOS_SUPPORT
	bool "TZ ICCC MOS SUPPORT"

config TZ_ICCC_NOS_SUPPORT
	bool "TZ ICCC NOS SUPPORT"

config TZ_ICCC
	bool "TZ ICCC"
	depends on TIMA && (TZ_ICCC_MOS_SUPPORT || TZ_ICCC_NOS_SUPPORT)
	default n
	---help---
	Provide kernel api for reading and writing ICCC secure parameters.
```
